## oplus/kernel/cpu/Kconfig
```kconfig
# SPDX-License-Identifier: GPL-2.0-only
# Copyright (C) 2018-2022 Oplus. All rights reserved.

config OPLUS_FEATURE_CPU
	bool "oplus cpu feature"
    default n
	help
	  Add for CPU Feature

source "$(KCONFIG_EXT_PREFIX)kernel/oplus_cpu/cpufreq_health/Kconfig"
source "$(KCONFIG_EXT_PREFIX)kernel/oplus_cpu/sched/Kconfig"
source "$(KCONFIG_EXT_PREFIX)kernel/oplus_cpu/oplus_game/Kconfig"
```

## oplus/kernel/dfr/Kconfig
```kconfig
# SPDX-License-Identifier: GPL-2.0-only
# Copyright (C) 2018-2022 Oplus. All rights reserved.

#ifdef OPLUS_FEATURE_PMIC_MONITOR
source "drivers/soc/oplus/dfr/qcom/qcom_pmic_monitor/Kconfig"
#endif /* OPLUS_FEATURE_PMIC_MONITOR */

#ifdef OPLUS_FEATURE_SHUTDOWN_DETECT
source "drivers/soc/oplus/dfr/common/shutdown_detect/Kconfig"
#endif /* OPLUS_FEATURE_SHUTDOWN_DETECT */

#ifdef OPLUS_FEATURE_KEYEVENT_HANDLER
source "drivers/soc/oplus/dfr/common/keyevent_handler/Kconfig"
#endif /* OPLUS_FEATURE_KEYEVENT_HANDLER */

#ifdef OPLUS_FEATURE_COMBKEY_MONITOR
source "drivers/soc/oplus/dfr/common/combkey_monitor/Kconfig"
#endif /* OPLUS_FEATURE_COMBKEY_MONITOR */
```

## oplus/kernel/secureguard/gki1.0/Kconfig
```kconfig
config OPLUS_KERNEL_SECURE_FEATURE
	tristate "config oplus kernel secure guard feature "
	default y
	help
		sdefine this config to add oplus kernel secure guard feature
```

## oplus/kernel/storage/storage_feature_in_module/Kconfig
```kconfig
source "drivers/soc/oplus/storage/common/storage_log/Kconfig"
source "drivers/soc/oplus/storage/common/ufs_oplus_dbg/Kconfig"
source "drivers/soc/oplus/storage/common/wq_dynamic_priority/Kconfig"
```
